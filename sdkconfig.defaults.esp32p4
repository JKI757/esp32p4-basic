## sdkconfig.defaults.esp32p4
```kconfig
# USB Serial JTAG Configuration
CONFIG_ESP_CONSOLE_USB_SERIAL_JTAG=y
CONFIG_ESP_CONSOLE_SECONDARY_NONE=y

# WiFi Configuration
CONFIG_ESP_WIFI_STATIC_RX_BUFFER_NUM=10
CONFIG_ESP_WIFI_DYNAMIC_RX_BUFFER_NUM=32
CONFIG_ESP_WIFI_DYNAMIC_TX_BUFFER_NUM=32
CONFIG_ESP_WIFI_AMPDU_TX_ENABLED=y
CONFIG_ESP_WIFI_AMPDU_RX_ENABLED=y

# ESP-Hosted Configuration
CONFIG_ESP_HOSTED_WIFI_ENABLED=y
CONFIG_ESP_HOSTED_TRANSPORT_SDIO=y

# ESP WiFi Remote Configuration
CONFIG_ESP_WIFI_REMOTE_LIBRARY_HOSTED=y
CONFIG_ESP_WIFI_REMOTE_ENABLED=y

# BLE Configuration (disabled for now - stub implementation)
# CONFIG_BT_ENABLED=y
# CONFIG_BT_CONTROLLER_DISABLED=y
# CONFIG_BT_BLUEDROID_ENABLED=n
# CONFIG_BT_NIMBLE_ENABLED=y
# CONFIG_BT_NIMBLE_TRANSPORT_UART=n

# ESP-Hosted BLE Configuration (disabled for now)
# CONFIG_ESP_HOSTED_ENABLE_BT_NIMBLE=y
# CONFIG_ESP_HOSTED_NIMBLE_HCI_VHCI=y

# Component Configuration
CONFIG_ESP_WIFI_ENABLED=y

# Memory Configuration
CONFIG_ESP_MAIN_TASK_STACK_SIZE=8192
CONFIG_ESP_TIMER_TASK_STACK_SIZE=4096

# Logging
CONFIG_LOG_DEFAULT_LEVEL_INFO=y
CONFIG_LOG_MAXIMUM_LEVEL_DEBUG=y
```
